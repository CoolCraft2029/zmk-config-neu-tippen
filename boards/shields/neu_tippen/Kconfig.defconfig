## boards/shields/neu_tippen/Kconfig.defconfig
```kconfig
if SHIELD_NEU_TIPPEN_LEFT

config ZMK_KEYBOARD_NAME
    default "neutippen"

config ZMK_SPLIT_ROLE_CENTRAL
    default y

endif # SHIELD_NEU_TIPPEN_LEFT

if SHIELD_NEU_TIPPEN_LEFT || SHIELD_NEU_TIPPEN_RIGHT

config ZMK_SPLIT
    default y

endif # SHIELD_NEU_TIPPEN_LEFT || SHIELD_NEU_TIPPEN_RIGHT
```

## boards/shields/neu_tippen/Kconfig.shield
```kconfig
config SHIELD_NEU_TIPPEN_LEFT
    def_bool $(shields_list_contains,neu_tippen_left)

config SHIELD_NEU_TIPPEN_RIGHT
    def_bool $(shields_list_contains,neu_tippen_right)
```
